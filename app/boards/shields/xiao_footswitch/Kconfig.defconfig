## app/boards/shields/xiao_footswitch/Kconfig.defconfig
```kconfig
# Copyright (c) 2020 The ZMK Contributors
# SPDX-License-Identifier: MIT

if SHIELD_XIAOFOOTSWITCH

config ZMK_KEYBOARD_NAME
    default "xiaofootswitch"

config ZMK_BLE
	default y

config ZMK_USB
	default y

config ZMK_BATTERY_VOLTAGE_DIVIDER
	default y

config USB_DEVICE_MANUFACTURER
	default "ZMK Project"
    
endif
```
